## boards/shields/alphalpha_plus/Kconfig.defconfig
```kconfig
# Copyright (c) 2020 The ZMK Contributors
# SPDX-License-Identifier: MIT

if SHIELD_ALPHALPHA_PLUS

config ZMK_KEYBOARD_NAME
    default "Alphalpha+"

endif
```

## boards/shields/alphalpha_plus/Kconfig.shield
```kconfig
# Copyright (c) 2020 The ZMK Contributors
# SPDX-License-Identifier: MIT

config SHIELD_ALPHALPHA_PLUS
   def_bool $(shields_list_contains,alphalpha_plus)
```
